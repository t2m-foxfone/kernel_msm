/* Copyright (c) 2013, The Linux Foundation. All rights reserved.
 *
 * This program is free software; you can redistribute it and/or modify
 * it under the terms of the GNU General Public License version 2 and
 * only version 2 as published by the Free Software Foundation.
 *
 * This program is distributed in the hope that it will be useful,
 * but WITHOUT ANY WARRANTY; without even the implied warranty of
 * MERCHANTABILITY or FITNESS FOR A PARTICULAR PURPOSE.  See the
 * GNU General Public License for more details.
 */

/*---------------------------------------------------------------------------
 * This file is autogenerated file using gcdb parser. Please do not edit it.
 * Update input XML file to add a new entry or update variable in this file
 * VERSION = "1.0"
 *---------------------------------------------------------------------------*/
&mdss_mdp {
	dsi_tianma_tm040ydh65_ili9806c_wvga_video: qcom,mdss_dsi_tianma_tm040ydh65_ili9806c_wvga_video {
		qcom,mdss-dsi-panel-name = "ili9806c wvga video mode dsi panel";
		qcom,mdss-dsi-panel-controller = <&mdss_dsi0>;
		qcom,mdss-dsi-panel-type = "dsi_video_mode";
		qcom,mdss-dsi-panel-destination = "display_1";
		qcom,mdss-dsi-panel-framerate = <60>;
		qcom,mdss-dsi-virtual-channel-id = <0>;
		qcom,mdss-dsi-stream = <0>;
		qcom,mdss-dsi-panel-width = <480>;
		qcom,mdss-dsi-panel-height = <854>;
                qcom,mdss-pan-physical-width-dimension = <48>;
                qcom,mdss-pan-physical-height-dimension = <85>;
		qcom,mdss-dsi-h-front-porch = <100>;
		qcom,mdss-dsi-h-back-porch = <100>;
		qcom,mdss-dsi-h-pulse-width = <10>;
		qcom,mdss-dsi-h-sync-skew = <0>;
		qcom,mdss-dsi-v-back-porch = <8>;
		qcom,mdss-dsi-v-front-porch = <20>;
		qcom,mdss-dsi-v-pulse-width = <12>;
		qcom,mdss-dsi-h-left-border = <0>;
		qcom,mdss-dsi-h-right-border = <0>;
		qcom,mdss-dsi-v-top-border = <0>;
		qcom,mdss-dsi-v-bottom-border = <0>;
		qcom,mdss-dsi-bpp = <24>;
		qcom,mdss-dsi-color-order = <0>;
		qcom,mdss-dsi-underflow-color = <0xff>;
		qcom,mdss-dsi-border-color = <0>;
		qcom,mdss-dsi-on-command = [39 01 00 00 00 00 04
						ff ff 98 16
					15 01 00 00 00 00 02
						ba 60
					15 01 00 00 00 00 02
						b0 01
					39 01 00 00 00 00 13
						bc 03 0d 03 63 01
						01 1b 11 6e 00 00
						00 01 01 16 00 ff
						f2
					39 01 00 00 00 00 09
						bd 02 13 45 67 45
						67 01 23
					39 01 00 00 00 00 12
						be 03 22 22 22 22
						dd cc bb aa 66 77
						22 22 22 22 22 22
					39 01 00 00 00 00 03
						ed 7f 0f
					15 01 00 00 00 00 02
					    f3 70
					15 01 00 00 00 00 02
					    b4 02
					39 01 00 00 00 00 04
						c0 0f 0b 0a
					39 01 00 00 00 00 05
						c1 17 88 70 20
					15 01 00 00 00 00 02
						d8 50
					15 01 00 00 00 00 02
						fc 07
					39 01 00 00 00 00 11
						e0 00 04 12 11 13
						1e c8 08 02 09 03
						0c 0c 2d 2a 00
					39 01 00 00 00 00 11
						e1 00 02 07 0d 11
						16 7a 09 05 09 06
						0c 0b 2f 2a 00
					39 01 00 00 00 00 09
						d5 0d 08 08 09 cb
						a5 01 04
					15 01 00 00 00 00 02
						f7 89
					15 01 00 00 00 00 02
						c7 7f
					15 01 00 00 00 00 02
                                            	fa 84
					05 01 00 00 38 00 02 11 00
					05 01 00 00 10 00 02 29 00];
		qcom,mdss-dsi-off-command = [05 01 00 00 32 00 02 28 00
					05 01 00 00 78 00 02 10 00];
		qcom,mdss-dsi-on-command-state = "dsi_lp_mode";
		qcom,mdss-dsi-off-command-state = "dsi_lp_mode";
		qcom,mdss-dsi-h-sync-pulse = <1>;
		qcom,mdss-dsi-traffic-mode = "non_burst_sync_pulse";
                qcom,mdss-dsi-lane-map = "lane_map_3012";
		qcom,mdss-dsi-bllp-eof-power-mode;
		qcom,mdss-dsi-bllp-power-mode;
		qcom,mdss-dsi-lane-0-state;
		qcom,mdss-dsi-lane-1-state;
		qcom,mdss-dsi-panel-timings = [8d 24 19 00 34 34 1d 26 2a 03 04 00];
		qcom,mdss-dsi-t-clk-post = <0x04>;
		qcom,mdss-dsi-t-clk-pre = <0x2d>;
		qcom,mdss-dsi-bl-min-level = <1>;
                qcom,mdss-dsi-bl-max-level = <255>;
		qcom,mdss-dsi-dma-trigger = "trigger_sw";
		qcom,mdss-dsi-mdp-trigger = "none";
		qcom,mdss-dsi-bl-pmic-control-type = "bl_ctrl_wled";
		qcom,mdss-dsi-reset-sequence = <1 50>, <0 50>, <1 120>;
	};
};
